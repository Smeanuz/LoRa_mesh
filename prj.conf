## CMakeLists.txt
```
# SPDX-License-Identifier: Apache-2.0

cmake_minimum_required(VERSION 3.20.0)
set(BOARD_FLASH_RUNNER stm32cubeprogrammer)

find_package(Zephyr REQUIRED HINTS $ENV{ZEPHYR_BASE})
project(Lora_network)

target_sources(app PRIVATE 
    src/main.c
    src/Core/LED/led_sts.c
    src/Core/CmdLine/cmd_line.c
    src/Core/CmdLine/cmd.c
    src/Core/LoRa/lora_app.c
    src/BSP/uart_cmd/uart_cmd.c
    src/BSP/lora/lora_radio.c
    src/protocol/common/protocol_packet.c
    src/protocol/common/protocol_config.c
    src/protocol/processor/packet_processor.c
    src/protocol/dispatcher/packet_dispatcher.c
    src/protocol/handler/ping_handler.c
    src/protocol/mesh/mesh_router.c
    src/protocol/mesh/mesh_duplicate.c
)

target_include_directories(app PRIVATE
    src/Core/LED
    src/BSP/uart_cmd
    src/Core/CmdLine
    src/Core/LoRa
    src/BSP/lora
    src/protocol/common
    src/protocol/processor
    src/protocol/dispatcher
    src/protocol/handler
    src/protocol/mesh
)
```

## prj.conf
```kconfig
# Enable GPIO 
CONFIG_GPIO=y

# Enable UART console   
CONFIG_SERIAL=y
CONFIG_UART_INTERRUPT_DRIVEN=y

# Enable LoRa support
CONFIG_LORA=y


CONFIG_MAIN_STACK_SIZE=4096
```

## debug.conf
```kconfig
# Kconfig bổ sung cho bản debug (thêm qua -DEXTRA_CONF_FILE=debug.conf)
# -Og thay cho -Os: step từng dòng chính xác, xem được biến local
CONFIG_DEBUG_OPTIMIZATIONS=y
# Cho J-Link GDB Server đọc danh sách thread Zephyr (panel RTOS / Call Stack)
CONFIG_DEBUG_THREAD_INFO=y
# Đặt tên thread và đo stack usage
CONFIG_THREAD_NAME=y
CONFIG_THREAD_STACK_INFO=y
CONFIG_INIT_STACKS=y
```

## boards/lora_e5_mini.overlay
```dts
&usart1 {
    status = "okay";
};
```

## src/main.c
```c
/*
 * Copyright (c) 2016 Intel Corporation
 *
 * SPDX-License-Identifier: Apache-2.0
 */

#include <stdio.h>
#include <zephyr/kernel.h>
#include <zephyr/drivers/gpio.h>


#include "led_sts.h"
#include "uart_cmd.h"
#include "cmd.h"
#include "lora_app.h"
#include "protocol_packet.h"
#include "packet_processor.h"


#define SLEEP_TIME_MS   10



int main(void)
{
	int ret;

    /* Initialize UART */
    ret = uart_cmd_init();
    if (ret < 0)
    {
        return ret;
    }

    /* Initialize CLI */
    cmdline_init();

    /* Initialize LED */
    ret = led_sts_init();
    if (ret < 0)
    {
        uart_cmd_SendLine("[ERROR] LED init failed");
    }

    /* Initialize LoRa */
    ret = lora_app_init();
    if (ret < 0)
    {
        uart_cmd_SendString("[ERROR] LoRa init failed: ");
        uart_cmd_SendInt(ret);
        uart_cmd_SendString("\r\n");
    }

    packet_processor_init();

    uart_cmd_SendLine("System initialized");


    while (1)
    {
        task_cmdline_update();

        k_msleep(SLEEP_TIME_MS);
    }
	return 0;
}
```
